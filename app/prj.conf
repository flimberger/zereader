## prj.conf
```kconfig
# SPDX-FileCopyrightText: 2025 Anna-Lena Marx <mail@marx.engineer>
#
# SPDX-License-Identifier: MPL-2.0

# https://docs.zephyrproject.org/latest/kconfig.html

# ZEREADER
CONFIG_ZEREADER_LOG_LEVEL_DBG=y

# General config
CONFIG_EVENTS=y
CONFIG_GPIO=y
CONFIG_SPI=y

CONFIG_SERIAL=y
# CONFIG_PRINTK=y
CONFIG_LOG=y
# immediate should only be used during development and not for timing critical stuff
CONFIG_LOG_MODE_IMMEDIATE=y
CONFIG_LOG_BACKEND_UART=y
CONFIG_UART_CONSOLE=y

####################################
# DISK ACCESS
####################################
CONFIG_DISK_ACCESS=y
CONFIG_DISK_DRIVER_SDMMC=y

CONFIG_FILE_SYSTEM=y
CONFIG_FAT_FILESYSTEM_ELM=y
CONFIG_FS_FATFS_EXFAT=y
# GPT support
CONFIG_FS_FATFS_LBA64=y
# Long file names (LFN)
CONFIG_FS_FATFS_LFN=y
# CONFIG_FS_FATFS_FF_USE_LFN=
# ONFIG_FS_FATFS_LFN_MODE=
CONFIG_FS_FATFS_LFN_MODE_STACK=y
CONFIG_FS_FATFS_MAX_LFN=255
# Commented out because default should be fine
# CONFIG_FS_FATFS_MAX_ROOT_ENTRIES=512
# CONFIG_FS_FATFS_MAX_SS=512
# CONFIG_FS_FATFS_NUM_DIRS=4
# CONFIG_FS_FATFS_NUM_FILES=4
# Unicode codepages
# CONFIG_FS_FATFS_CODEPAGE=

# For Debug Output
CONFIG_SD_LOG_LEVEL_DBG=n
CONFIG_SDHC_LOG_LEVEL_DBG=n
CONFIG_SDMMC_LOG_LEVEL_DBG=n

# Config memory
# Make sure the configured stack size matches the size of
# e.g. read buffer arrays!
CONFIG_INIT_STACKS=y
CONFIG_MAIN_STACK_SIZE=10240
CONFIG_HEAP_MEM_POOL_SIZE=50960
CONFIG_IDLE_STACK_SIZE=320
CONFIG_SYSTEM_WORKQUEUE_STACK_SIZE=1024
# CONFIG_ISR_STACK_SIZE=8128

CONFIG_DISPLAY=y
CONFIG_DISPLAY_LOG_LEVEL_DBG=n
CONFIG_UC81XX=y

CONFIG_INPUT=y
CONFIG_INPUT_EVENT_DUMP=y

####################################
# LVGL
####################################
CONFIG_LVGL=y
CONFIG_APP_LINK_WITH_LVGL=y
CONFIG_LV_Z_AUTO_INIT=y
# CONFIG_LV_Z_BUTTON_INPUT=y
CONFIG_LV_Z_BUTTON_INPUT_MSGQ_COUNT=4
# CONFIG_LV_Z_ENCODER_INPUT
# CONFIG_LV_Z_FLUSH_THREAD=y
# CONFIG_LV_Z_FLUSH_THREAD_PRIORITY=-1
# CONFIG_LV_Z_FLUSH_THREAD_STACK_SIZE=1024 TODO
# CONFIG_LV_Z_FULL_REFRESH
# CONFIG_LV_Z_INIT_PRIORITY=90
# CONFIG_LV_Z_KEYPAD_INPUT
# CONFIG_LV_Z_POINTER_INPUT
# CONFIG_LV_Z_SHELL
# CONFIG_LV_Z_USE_FILESYSTEM=y

# CONFIG_LV_Z_BITS_PER_PIXEL=1
CONFIG_LV_COLOR_DEPTH_1=y
# CONFIG_LV_COLOR_DEPTH_8=y

# LVGL Memory
# CONFIG_LV_Z_MEMORY_POOL
# CONFIG_LV_Z_MEMORY_POOL_CUSTOM_SECTION
# CONFIG_LV_Z_MEM_POOL_HEAP_LIB_C
CONFIG_LV_Z_MEM_POOL_SIZE=32768
# CONFIG_LV_Z_MEM_POOL_SYS_HEAP=n
# CONFIG_LV_Z_BUFFER_ALLOC_DYNAMIC
# CONFIG_LV_Z_BUFFER_ALLOC_STATIC
# CONFIG_LV_Z_RENDERING_BUFFER_ALLOCATION

# Use two rendering buffers
CONFIG_LV_Z_DOUBLE_VDB=y

# CONFIG_LV_Z_MONOCHROME_CONVERSION_BUFFER=y
CONFIG_LV_Z_FULL_REFRESH=n
# Huge RAM influence!
CONFIG_LV_Z_VDB_SIZE=100
# CONFIG_LV_Z_VDB_ALIGN=4
# CONFIG_LV_Z_VDB_CUSTOM_SECTION

# parallel rendering
# CONFIG_LV_Z_USE_OSAL

# LVGL CONFIGS from the module
CONFIG_LV_USE_THEME_MONO=y
CONFIG_LV_DRAW_SW_I1_LUM_THRESHOLD=65


# CONFIG_LV_FONT_DEFAULT_MONTSERRAT_12=y
# CONFIG_LV_TXT_ENC_UTF8=y

CONFIG_LV_USE_LOG=y
# LV_TXT_LINE_BREAK_LONG_LEN
# CONFIG_LV_USE_LIBPNG=y
# CONFIG_LV_USE_LIBJPEG_TURBO=y
```

## src/main.c
```c
/*
 * SPDX-FileCopyrightText: 2025 Anna-Lena Marx <mail@marx.engineer>
 *
 * SPDX-License-Identifier: MPL-2.0
 */

#include <stdio.h>
#include <zephyr/logging/log.h>
#include <zephyr/device.h>
#include <zephyr/devicetree.h>
#include <zephyr/drivers/display.h>
#include <zephyr/kernel.h>

#include <epub/epub.h>
#include <ui/ui.h>

LOG_MODULE_REGISTER(main, CONFIG_ZEREADER_LOG_LEVEL);

enum main_event_flags {
	MAIN_EVENT_UPDATE_LVGL = 0x01,
};

static K_EVENT_DEFINE(main_event);

void update_lvgl(void)
{
	k_event_post(&main_event, MAIN_EVENT_UPDATE_LVGL);
}

int main(void)
{
	LOG_DBG("ZEReader started! %s\n", CONFIG_BOARD_TARGET);

	// Initialize the choosen zephyr,display device
	// -> Make the device tree description available for the software part
	display_dev = DEVICE_DT_GET(DT_CHOSEN(zephyr_display));
	if (!device_is_ready(display_dev))
	{
		LOG_ERR("Device not ready, aborting...");
		return 0;
	}

	// Make the FIRST ok zephyr,lvgl-button-input node available to the software part
	static const struct device *lvgl_btn_dev;
	lvgl_btn_dev = DEVICE_DT_GET(DT_COMPAT_GET_ANY_STATUS_OKAY(zephyr_lvgl_button_input));
	if (!device_is_ready(lvgl_btn_dev))
	{
		LOG_ERR("Device not ready, aborting...");
		return 0;
	}

	context_t context = READING;

	zereader_setup_page();
	zereader_setup_control_buttons(&context);
	zereader_show_logo();
	lv_timer_handler();
	display_blanking_off(display_dev);

	epub_initialize();
	epub_restore_book();

	zereader_clean_page();

	zereader_print_current_page();

	k_timeout_t timeout = K_NO_WAIT;
	while (1)
	{
		/* For now there is only a single event, used for waking up the main loop */
		k_event_wait(&main_event, 0xFF, true, timeout);
		uint32_t sleep_ms = lv_timer_handler();
		if (sleep_ms == LV_NO_TIMER_READY) {
			timeout = K_FOREVER;
		} else {
			timeout = K_MSEC(MIN(sleep_ms, INT32_MAX));
		}
	}

	return 0;
}
```
